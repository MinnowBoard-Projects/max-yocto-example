## conf/layer.conf
```bitbake
# We have a conf and classes directory, add to BBPATH
BBPATH .= ":${LAYERDIR}"

# We have recipes-* directories, add to BBFILES
BBFILES += "${LAYERDIR}/recipes-*/*/*.bb \
        ${LAYERDIR}/recipes-*/*/*.bbappend"

BBFILE_COLLECTIONS += "minnowboardmax"
BBFILE_PATTERN_minnowboardmax = "^${LAYERDIR}/"
BBFILE_PRIORITY_minnowboardmax = "6"
```
